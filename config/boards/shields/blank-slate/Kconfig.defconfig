## config/boards/shields/blank-slate/Kconfig.defconfig
```kconfig
if SHIELD_BLANK_SLATE

# Name must be less than 16 characters long!
config ZMK_KEYBOARD_NAME
    default "Blank Slate"

endif
```

## config/boards/shields/blank-slate/Kconfig.shield
```kconfig
# No whitespace after the comma or in your keyboard name!
# El shield para el teclado Blank Slate
config SHIELD_BLANK_SLATE
    def_bool $(shields_list_contains,blank-slate)
```
